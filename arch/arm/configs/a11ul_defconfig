## drivers/i2c/chips/Kconfig
```kconfig
#
# Miscellaneous I2C chip drivers configuration
#
# *** DEPRECATED! Do not add new entries! See Makefile ***
#

menu "Miscellaneous I2C Chip support"

config INPUT_CWSTM32
       tristate "CyWee CWSTM32 Sensor HUB"
       depends on I2C && INPUT
       select INPUT_POLLDEV
       help
         This driver provides support for CWSTM32 Sensor HUB.

config SENSORS_NFC_PN544
	tristate "PN544 NFC sensor support"
	depends on I2C=y
	help
	PN544 NFC Driver implemented.

config INPUT_CAPELLA_CM32181
        tristate "CM32181 light sensor"
        help
          Say Y here to enable the CM32181 Ambient Light Sensor.

config AMP_RT5506
        tristate "Richtek RT5506 AMP Driver"
	depends on I2C=y
        help
          Richtek RT5506 AMP Driver implemented by HTC.

config AMP_TFA9887
        tristate "NXP TFA9887 Speaker AMP Driver"
	depends on I2C=y
        help
         NXP TFA9887 Speaker AMP Driver implemented by HTC.

config AMP_TFA9887L
        tristate "NXP TFA9887L Speaker AMP Driver"
	depends on I2C=y
        help
         NXP TFA9887L Speaker AMP Driver implemented by HTC.

config SYNC_TOUCH_STATUS
        bool "Sync touch i2c switch status to sensor hub"
	default n
	help
	  Sync touch i2c switch status to sensor hub

endmenu
```

## drivers/i2c/sensors/Kconfig
```kconfig
#
# Miscellaneous I2C sensor drivers configuration
#
# *** DEPRECATED! Do not add new entries! See Makefile ***
#

menu "Miscellaneous I2C Chip support"

config SENSORS_ONLY_BMA255
	tristate "BMA255 acceleration sensor support"
	depends on I2C=y
	help
	  BMA255 ONLY G-sensor Driver implemented by HTC.

endmenu
```

## drivers/nfc/Kconfig
```kconfig
#
# Near Field Communication (NFC) devices
#

menu "Near Field Communication (NFC) devices"
	depends on NFC

config NFC_PN533
	tristate "NXP PN533 USB driver"
	depends on USB
	help
	  NXP PN533 USB driver.
	  This driver provides support for NFC NXP PN533 devices.

	  Say Y here to compile support for PN533 devices into the
	  kernel or say M to compile it as module (pn533).

config NFC_WILINK
	tristate "Texas Instruments NFC WiLink driver"
	depends on TI_ST && NFC_NCI
	help
	  This enables the NFC driver for Texas Instrument's BT/FM/GPS/NFC
	  combo devices. This makes use of shared transport line discipline
	  core driver to communicate with the NFC core of the combo chip.

	  Say Y here to compile support for Texas Instrument's NFC WiLink driver
	  into the kernel or say M to compile it as module.

endmenu

config NFC_QNCI
	bool "Qualcomm NCI based NFC Controller Driver for qca199x"
	depends on I2C
	select CRC_CCITT
	help
	  This enables the NFC driver for QCA199x based devices.
	  This is for i2c connected version. NCI protocol logic
	  resides in the usermode and it has no other NFC dependencies.

config SENSORS_NFC_PN544
	tristate "PN544 NFC sensor support"
	depends on I2C=y
	---help---
	  PN544 NFC Driver implemented by HTC.
```
